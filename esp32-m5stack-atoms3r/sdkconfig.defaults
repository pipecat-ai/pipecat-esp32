## esp32-m5stack-atoms3r/sdkconfig.defaults
```kconfig
CONFIG_IDF_TARGET="esp32s3"

# Enable PSRAM
CONFIG_SPIRAM=y
CONFIG_SPIRAM_MODE_QUAD=n
CONFIG_SPIRAM_MODE_OCT=y

# Performance
CONFIG_ESP_DEFAULT_CPU_FREQ_MHZ_240=y
CONFIG_FREERTOS_HZ=1000
CONFIG_COMPILER_OPTIMIZATION_PERF=y

# Enable DTLS
CONFIG_MBEDTLS_SSL_PROTO_DTLS=y

# Defaults to partitions.csv
CONFIG_PARTITION_TABLE_CUSTOM=y

# libpeer requires large stack allocations
CONFIG_ESP_MAIN_TASK_STACK_SIZE=16384
```
